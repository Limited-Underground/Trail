## firmware/targets/heltec_v4_bench/sdkconfig.defaults
```kconfig
# Build-only ESP32-S3 candidate defaults. This target is not flash-authorized.
CONFIG_ESP_CONSOLE_USB_SERIAL_JTAG=y
CONFIG_LOG_DEFAULT_LEVEL_INFO=y
CONFIG_LOG_MAXIMUM_LEVEL=3
CONFIG_COMPILER_OPTIMIZATION_SIZE=y
CONFIG_APP_COMPILE_TIME_DATE=n
CONFIG_ESPTOOLPY_OCT_FLASH=n
CONFIG_ESPTOOLPY_FLASH_MODE_AUTO_DETECT=n
CONFIG_ESPTOOLPY_FLASHMODE_QIO=y
CONFIG_ESPTOOLPY_FLASH_SAMPLE_MODE_STR=y
CONFIG_ESPTOOLPY_FLASHFREQ_80M=y
CONFIG_ESPTOOLPY_FLASHSIZE_16MB=y
CONFIG_ESPTOOLPY_HEADER_FLASHSIZE_UPDATE=n
CONFIG_PARTITION_TABLE_CUSTOM=y
CONFIG_PARTITION_TABLE_CUSTOM_FILENAME="partitions.csv"
CONFIG_SPIRAM=y
CONFIG_SPIRAM_MODE_QUAD=y
CONFIG_SPIRAM_TYPE_ESPPSRAM16=y
CONFIG_SPIRAM_SPEED_80M=y
CONFIG_SPIRAM_BOOT_HW_INIT=y
CONFIG_SPIRAM_BOOT_INIT=y
CONFIG_SPIRAM_IGNORE_NOTFOUND=n
CONFIG_SPIRAM_MEMTEST=y
CONFIG_SPIRAM_USE_CAPS_ALLOC=y
CONFIG_BT_ENABLED=y
CONFIG_BT_CONTROLLER_ENABLED=y
CONFIG_BT_NIMBLE_ENABLED=y
CONFIG_BT_NIMBLE_ROLE_CENTRAL=n
CONFIG_BT_NIMBLE_ROLE_PERIPHERAL=y
CONFIG_BT_NIMBLE_ROLE_BROADCASTER=n
CONFIG_BT_NIMBLE_ROLE_OBSERVER=n
CONFIG_BT_NIMBLE_GATT_CLIENT=n
CONFIG_BT_NIMBLE_GATT_SERVER=y
CONFIG_BT_NIMBLE_MAX_CONNECTIONS=1
CONFIG_BT_NIMBLE_MAX_BONDS=1
CONFIG_BT_NIMBLE_SECURITY_ENABLE=y
CONFIG_BT_NIMBLE_SM_LEGACY=n
CONFIG_BT_NIMBLE_SM_SC=y
CONFIG_BT_NIMBLE_SM_SC_DEBUG_KEYS=n
CONFIG_BT_NIMBLE_LL_CFG_FEAT_LE_ENCRYPTION=y
CONFIG_BT_NIMBLE_SM_LVL=3
CONFIG_BT_NIMBLE_SM_SC_ONLY=1
CONFIG_BT_NIMBLE_NVS_PERSIST=n
```

## firmware/targets/heltec_v4_enrollment_candidate_eval/sdkconfig.defaults
```kconfig
# Isolated USB evaluation: no product BLE host task, GAP or RF path.
CONFIG_IDF_TARGET_ESP32S3=y
CONFIG_ESP_CONSOLE_NONE=y
CONFIG_LOG_DEFAULT_LEVEL_NONE=y
CONFIG_LOG_MAXIMUM_EQUALS_DEFAULT=y
CONFIG_BOOTLOADER_LOG_LEVEL_NONE=y
CONFIG_COMPILER_OPTIMIZATION_SIZE=y
CONFIG_APP_REPRODUCIBLE_BUILD=y
CONFIG_APP_COMPILE_TIME_DATE=n
CONFIG_ESPTOOLPY_FLASHMODE_QIO=y
CONFIG_ESPTOOLPY_FLASHFREQ_80M=y
CONFIG_ESPTOOLPY_FLASHSIZE_16MB=y
CONFIG_ESP_MAIN_TASK_STACK_SIZE=24576
CONFIG_PARTITION_TABLE_CUSTOM=y
CONFIG_PARTITION_TABLE_CUSTOM_FILENAME="partitions.csv"
CONFIG_BT_ENABLED=y
CONFIG_BT_CONTROLLER_ENABLED=y
CONFIG_BT_NIMBLE_ENABLED=y
CONFIG_BT_NIMBLE_MAX_CONNECTIONS=1
CONFIG_BT_NIMBLE_MAX_BONDS=2
CONFIG_BT_NIMBLE_SECURITY_ENABLE=y
CONFIG_BT_NIMBLE_SM_LEGACY=n
CONFIG_BT_NIMBLE_SM_SC=y
CONFIG_BT_NIMBLE_SM_SC_DEBUG_KEYS=n
CONFIG_BT_NIMBLE_LL_CFG_FEAT_LE_ENCRYPTION=y
CONFIG_BT_NIMBLE_SM_LVL=3
CONFIG_BT_NIMBLE_SM_SC_ONLY=1
CONFIG_BT_NIMBLE_NVS_PERSIST=y
CONFIG_BT_CTRL_MODEM_SLEEP=n
CONFIG_PM_ENABLE=n
CONFIG_LIBSODIUM_USE_MBEDTLS_SHA=n
```

## firmware/targets/heltec_v4_security_policy_diag/sdkconfig.defaults
```kconfig
# Build-only evaluation: no LoRa or product BLE host; no flash authority.
CONFIG_IDF_TARGET_ESP32S3=y
CONFIG_ESP_CONSOLE_USB_SERIAL_JTAG=y
CONFIG_LOG_DEFAULT_LEVEL_NONE=y
CONFIG_LOG_MAXIMUM_EQUALS_DEFAULT=y
CONFIG_COMPILER_OPTIMIZATION_SIZE=y
CONFIG_APP_REPRODUCIBLE_BUILD=y
CONFIG_APP_COMPILE_TIME_DATE=n
CONFIG_ESPTOOLPY_FLASHMODE_QIO=y
CONFIG_ESPTOOLPY_FLASHFREQ_80M=y
CONFIG_ESPTOOLPY_FLASHSIZE_16MB=y
CONFIG_ESP_MAIN_TASK_STACK_SIZE=16384
CONFIG_PARTITION_TABLE_CUSTOM=y
CONFIG_PARTITION_TABLE_CUSTOM_FILENAME="partitions.csv"
CONFIG_BT_ENABLED=y
CONFIG_BT_CONTROLLER_ENABLED=y
CONFIG_BT_NIMBLE_ENABLED=y
CONFIG_BT_CTRL_MODEM_SLEEP=n
CONFIG_PM_ENABLE=n
CONFIG_LIBSODIUM_USE_MBEDTLS_SHA=n
```

## tests/benchmarks/crypto/esp_idf/espressif_libsodium_1_0_22/sdkconfig.defaults
```kconfig
CONFIG_IDF_TARGET="esp32s3"
CONFIG_APP_REPRODUCIBLE_BUILD=y
CONFIG_APP_COMPILE_TIME_DATE=n
```

## tests/benchmarks/crypto/esp_idf/ot121_candidate_benchmarks/monocypher_ot163_control/sdkconfig.defaults
```kconfig
# Host-only ESP32-S3 Monocypher quiet-target defaults. Not flash-authorized.
CONFIG_ESP_CONSOLE_NONE=y
CONFIG_ESP_CONSOLE_SECONDARY_NONE=y
CONFIG_BOOTLOADER_LOG_LEVEL_NONE=y
CONFIG_LOG_DEFAULT_LEVEL_NONE=y
CONFIG_LOG_MAXIMUM_EQUALS_DEFAULT=y
CONFIG_LOG_DYNAMIC_LEVEL_CONTROL=y
CONFIG_USJ_ENABLE_USB_SERIAL_JTAG=y
CONFIG_COMPILER_OPTIMIZATION_SIZE=y
CONFIG_APP_COMPILE_TIME_DATE=n
CONFIG_ESPTOOLPY_OCT_FLASH=n
CONFIG_ESPTOOLPY_FLASH_MODE_AUTO_DETECT=n
CONFIG_ESPTOOLPY_FLASHMODE_QIO=y
CONFIG_ESPTOOLPY_FLASH_SAMPLE_MODE_STR=y
CONFIG_ESPTOOLPY_FLASHFREQ_80M=y
CONFIG_ESPTOOLPY_FLASHSIZE_16MB=y
CONFIG_ESPTOOLPY_HEADER_FLASHSIZE_UPDATE=n
CONFIG_PARTITION_TABLE_CUSTOM=y
CONFIG_PARTITION_TABLE_CUSTOM_FILENAME="partitions.csv"
CONFIG_SPIRAM=y
CONFIG_SPIRAM_MODE_QUAD=y
CONFIG_SPIRAM_TYPE_ESPPSRAM16=y
CONFIG_SPIRAM_SPEED_80M=y
CONFIG_SPIRAM_BOOT_HW_INIT=y
CONFIG_SPIRAM_BOOT_INIT=y
CONFIG_SPIRAM_IGNORE_NOTFOUND=n
CONFIG_SPIRAM_MEMTEST=y
CONFIG_SPIRAM_USE_CAPS_ALLOC=y
CONFIG_APP_REPRODUCIBLE_BUILD=y
```
